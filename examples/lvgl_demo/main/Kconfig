## examples/lvgl_demo/main/Kconfig
```kconfig
menu "Example Configuration"

	config VIDEO_MODE_NTSC
		bool "NTSC video mode instead of default PAL/SECAM"
		default n
		help
			Configure example to work with NTSC used mostly in North America and Japan.
			Default PAL/SECAM is used in Europe and other countries.
endmenu
```

## examples/lvgl_demo/sdkconfig.defaults
```kconfig
# Optimize for performance
CONFIG_COMPILER_OPTIMIZATION_PERF=y

CONFIG_ESP_DEFAULT_CPU_FREQ_MHZ_240=y
CONFIG_ESP_DEFAULT_CPU_FREQ_MHZ=240

CONFIG_VIDEO_ENABLE_LVGL_SUPPORT=y
```

## examples/test_pattern/sdkconfig.defaults
```kconfig
# Optimize for performance
CONFIG_COMPILER_OPTIMIZATION_PERF=y

CONFIG_ESP_DEFAULT_CPU_FREQ_MHZ_240=y
CONFIG_ESP_DEFAULT_CPU_FREQ_MHZ=240

CONFIG_VIDEO_DIAG_DISPLAY_TEST_FUNC=y
```
